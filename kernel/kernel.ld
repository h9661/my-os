/* ============================================================================
 * 커널 링커 스크립트 (Kernel Linker Script)
 * ============================================================================
 * 파일: kernel.ld
 * 역할: 1) 커널 바이너리 메모리 레이아웃 정의 2) 섹션 배치 규칙 설정 
 *       3) 물리 주소 매핑 4) 페이지 정렬 보장
 * 
 * 이 링커 스크립트는 커널의 각 섹션(.text, .data, .bss 등)을 메모리의 
 * 특정 위치에 배치하고, 부트로더와의 인터페이스를 정의함
 */

/* === 1. 진입점 정의 (Entry Point Definition) === */
/* _start: 커널이 실행을 시작할 함수의 심볼명
 * 부트로더가 커널을 로드한 후 점프할 첫 번째 명령어의 위치
 * kernel_entry.asm에서 정의된 _start 레이블과 연결됨 */
ENTRY(_start)

/* === 2. 출력 형식 및 아키텍처 설정 === */
/* ELF32 형식으로 바이너리 생성 (32비트 실행 파일 형식)
 * i386: Intel 80386 이상의 32비트 x86 아키텍처 대상 */
OUTPUT_FORMAT(elf32-i386)
OUTPUT_ARCH(i386)

/* === 3. 메모리 섹션 레이아웃 정의 === */
SECTIONS
{
    /* === 커널 로드 주소 설정 === */
    /* 0x10000 (64KB): 커널이 메모리에 로드될 물리 주소
     * 이 주소는 2단계 부트로더에서 설정한 KERNEL_OFFSET과 일치해야 함
     * 
     * 2단계 부트 시스템 메모리 맵:
     * 0x0000-0x7BFF: 사용 가능한 저메모리 (약 31KB)
     * 0x7C00-0x7DFF: 1단계 부트로더 (512 bytes, BIOS가 로드)
     * 0x7E00-0x9FFF: 2단계 부트로더 (4KB, 1단계가 로드)
     * 0x10000-0x22000: 커널 코드 및 데이터 (최대 ~72KB)
     * 0x90000: 스택 영역 (576KB 위치에서 아래로 성장)
     * 
     * 2단계 부트의 장점:
     * - 더 큰 커널 지원 (최대 50KB+ 가능)
     * - 더 안전한 메모리 레이아웃
     * - 확장 가능한 부트로더 기능
     */
    . = 0x10000;

    /* === 4-1. 코드 섹션 (.text) === */
    /* 실행 가능한 기계어 코드가 저장되는 섹션
     * 커널 진입점부터 시작하여 연속으로 배치 (메모리 효율성 우선)
     * *(.text): 모든 입력 파일의 .text 섹션을 이 위치에 배치 */
    .text : 
    {
        *(.text)    /* kernel_entry.o, kernel.o 등의 .text 섹션 통합 */
    }

    /* === 4-2. 읽기 전용 데이터 섹션 (.rodata) === */
    /* 상수 데이터, 문자열 리터럴 등이 저장되는 섹션
     * 실행 시 수정할 수 없는 데이터 (Read-Only Data)
     * 예: printf에서 사용하는 문자열, const 변수들 */
    .rodata : ALIGN(4)
    {
        *(.rodata)  /* 모든 읽기 전용 데이터를 4바이트 정렬하여 배치 */
        *(.rodata.*)
    }

    /* === 4-3. 읽기/쓰기 데이터 섹션 (.data) === */
    /* 초기값이 있는 전역 변수들이 저장되는 섹션
     * 실행 시 읽기와 쓰기가 모두 가능한 데이터
     * 예: int global_var = 42; 같은 초기화된 전역 변수 */
    .data : ALIGN(4)
    {
        *(.data)    /* 모든 초기화된 데이터를 4바이트 정렬하여 배치 */
        *(.data.*)
    }

    /* === 4-4. 미초기화 데이터 섹션 (.bss) === */
    /* 초기값이 없는 전역 변수들을 위한 섹션
     * Block Started by Symbol의 줄임말
     * 실행 파일에는 공간만 예약되고 실제 데이터는 저장되지 않음
     * 프로그램 로드 시 0으로 초기화됨 */
    .bss : ALIGN(4)
    {
        __bss_start = .;    /* BSS 시작 주소 표시 */
        
        /* COMMON: 여러 파일에서 동일한 이름으로 선언된 변수들
         * 링커가 하나로 통합하는 섹션 */
        *(COMMON)
        
        /* .bss: 일반적인 미초기화 변수들
         * 예: int uninitialized_array[1000]; */
        *(.bss)
        *(.bss.*)
        
        __bss_end = .;      /* BSS 끝 주소 표시 */
    }
    
    /* === 커널 끝 주소 표시 === */
    __kernel_end = .;
}

/* === 메모리 레이아웃 요약 ===
 * 
 * 물리 메모리 주소 (최적화된 레이아웃, 커널 ~28KB):
 * ┌─────────────────────────────────────────────────────────┐
 * │ 0x1000: .text (코드) - 커널의 모든 실행 코드            │
 * │ - _start 진입점                                         │  
 * │ - 모든 함수의 기계어 코드 (~26KB)                       │
 * ├─────────────────────────────────────────────────────────┤
 * │ .rodata (읽기 전용 데이터) - 바로 이어서 배치           │
 * │ - 문자열 상수, const 변수들 (~1KB)                      │
 * ├─────────────────────────────────────────────────────────┤
 * │ .data (초기화된 데이터) - 연속 배치                     │
 * │ - 초기값 있는 전역 변수 (~1KB)                          │
 * ├─────────────────────────────────────────────────────────┤
 * │ .bss (미초기화 데이터) - 연속 배치                      │
 * │ - 0으로 초기화될 전역 변수들                            │
 * │ - 커널 총 크기: 0x1000 + 28KB = ~0x8000               │
 * ├─────────────────────────────────────────────────────────┤
 * │ 0x8000-0x9000: 여유 공간 (4KB - 충분한 안전 마진)       │
 * ├─────────────────────────────────────────────────────────┤
 * │ 0x9000: 스택 영역 시작점 (안전한 거리 확보)             │
 * │ - 스택은 0x9000에서 아래쪽으로 성장                     │
 * │ - 32비트 모드에서는 0x90000 사용                        │
 * └─────────────────────────────────────────────────────────┘
 * 
 * ✅ 최적화 결과:
 * - 메모리 효율성: 4KB 정렬 제거로 최대 12KB 절약
 * - 안전성: 4KB 여유 공간으로 스택 충돌 방지
 * - 확장성: 추가 4KB까지 커널 확장 가능
 * 
 * 📝 참고:
 * - 4바이트 정렬로 CPU 성능 최적화 유지
 * - __kernel_end 심볼로 커널 크기 추적 가능
 * - __bss_start, __bss_end로 BSS 초기화 가능
 */
